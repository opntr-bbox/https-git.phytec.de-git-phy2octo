## tools/meta-phydev/conf/bblayers.conf.sample
```bitbake
# LAYER_CONF_VERSION is increased each time build/conf/bblayers.conf
# changes incompatibly
LCONF_VERSION = "6"

BBPATH = "${TOPDIR}"
BBFILES ?= ""

BBLAYERS ?= " \
  ${HOME}/meta-phydev \
  ${TOPDIR}/../sources/poky/meta-yocto \
  ${TOPDIR}/../sources/poky/meta-yocto-bsp \
  ${TOPDIR}/../sources/poky/meta \
  ${TOPDIR}/../sources/meta-phytec/meta-phyam335x \
  ${TOPDIR}/../sources/meta-phytec \
  ${TOPDIR}/../sources/meta-yogurt \
  ${TOPDIR}/../sources/meta-openembedded/meta-oe \
  ${TOPDIR}/../sources/meta-openembedded/meta-systemd \
  ${TOPDIR}/../sources/meta-openembedded/meta-gnome \
  ${TOPDIR}/../sources/meta-openembedded/meta-gpe \
  ${TOPDIR}/../sources/meta-angstrom \
  ${TOPDIR}/../sources/meta-qt5 \
"

BBLAYERS_NON_REMOVABLE ?= " \
  ${TOPDIR}/../sources/poky/meta \
  ${TOPDIR}/../sources/poky/meta-yocto \
"
```

## tools/meta-phydev/conf/layer.conf
```bitbake
# We have a conf and classes directory, add to BBPATH
BBPATH .= ":${LAYERDIR}"

# We have a recipes directory, add to BBFILES
BBFILES += "${LAYERDIR}/recipes-*/*/*.bb \
	    ${LAYERDIR}/recipes-*/*/*.bbappend"

BBFILE_COLLECTIONS += "phyDev"
BBFILE_PATTERN_phyDev = "^${LAYERDIR}/"
BBFILE_PRIORITY_phyDev = "30"
LAYERVERSION_phyDev = "1"

# Layer dependencies
LAYERDEPENDS_phyDev = "phytec"

# Developer settings
DEV_BUILD = "True"
DEV_USER = "smk"
#DEV_USER = "${USER}"
TFTP_ROOT = "/tftpboot"
NFS_ROOT = "/nfsroot"
SDCARD_MOUNT = "/media/mueller-klieser"
SDCARD_BOOTPART = "/boot"
SDCARD_ROOTFSPART = "/rootfs"
BAREBOX_BOOTSRC = "net"
#IMAGE_INSTALL_append = " task-native-sdk iperf"
```

## tools/meta-phydev/conf/local.conf.sample
```bitbake
DISTRO = "poky"
MACHINE = "phyflex-am335x-1"
#MACHINE ?= "phycore-am335x-1"
#IMAGE_FSTYPES += "sdimg-phy"
#IMAGE_FSTYPES += "tar.gz"
BB_NUMBER_THREADS ?= "6"
#"${@oe.utils.cpu_count()}"
PARALLEL_MAKE ?= "-j 32"
#${@oe.utils.cpu_count()}"
DL_DIR ?= "/home/yocto_downloads"
SSTATE_DIR ?= "/home/yocto_sstate/1.7"
DEPLOY_DIR = "${TOPDIR}/deploy"
TMPDIR = "${TOPDIR}/tmp"
PACKAGE_CLASSES ?= "package_ipk"
SDKMACHINE ?= "x86_64"
EXTRA_IMAGE_FEATURES = "debug-tweaks"
USER_CLASSES ?= "buildstats image-mklibs image-prelink"
#TEST_IMAGE = "1"
OE_TERMINAL = "auto"
PATCHRESOLVE = "noop"
BB_DISKMON_DIRS = "\
    STOPTASKS,${TMPDIR},1G,100K \
    STOPTASKS,${DL_DIR},1G,100K \
    STOPTASKS,${SSTATE_DIR},1G,100K \
    ABORT,${TMPDIR},100M,1K \
    ABORT,${DL_DIR},100M,1K \
    ABORT,${SSTATE_DIR},100M,1K" 
CONF_VERSION = "1"
#CCACHE = "ccache"
#INHERIT += "ccache"
#CCACHE_DIR = "/home/mueller-klieser/.ccache"
#CCACHE_DISABLE = "0"
```
